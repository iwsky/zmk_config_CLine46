## config/west.yml
```yaml
manifest:
  remotes:
    - name: cormoran
      url-base: https://github.com/cormoran
#    - name: badjeff    # <-- PMW3610
#      url-base: https://github.com/badjeff
    - name: caksoylar  # <-- RGB LED
      url-base: https://github.com/caksoylar
    - name: takamaru-fpv  # <-- Battery level smoothing
      url-base: https://github.com/takamaru-fpv

  projects:
    # ZMK: DYA Studio 用カスタム RPC サブシステム付き cormoran fork
    - name: zmk
      remote: cormoran
      revision: main+dya
      import:
        file: app/west.yml
    - name: zephyr
      remote: cormoran
      revision: v4.1.0+zmk-fixes+nrf-half-duplex-uart
      clone-depth: 1
      import:
        name-blocklist:
          - ci-tools
          - hal_altera
          - hal_cypress
          - hal_infineon
          - hal_microchip
          - hal_nxp
          - hal_openisa
          - hal_xtensa
          - hal_st
          - hal_ti
          - loramac-node
          - mcuboot
          - mcumgr
          - net-tools
          - openthread
          - edtt
          - trusted-firmware-m

    - name: zmk-feature-non-lipo-battery-management
      remote: takamaru-fpv
      revision: voltage_division

#    - name: zmk-pmw3610-driver
#      remote: badjeff
#      revision: zmk-0.4

    - name: zmk-rgbled-widget
      remote: caksoylar
      revision: main

    # DYA Studio モジュール（すべて cormoran リポジトリ）
    # DYA Studio CORE Module
    - name: zmk-feature-custom-settings
      remote: cormoran
      revision: main
    - name: zmk-feature-fast-keymap
      remote: cormoran
      revision: main

    # キーマップ、Macro、Combo
#    - name: zmk-feature-runtime-macro
#      remote: cormoran
#      revision: main
#    - name: zmk-feature-runtime-combo
#      remote: cormoran
#      revision: main
#    - name: zmk-feature-input-stream # 押下キー表示が必要な場合だけ
#      remote: cormoran
#      revision: main
#    - name: zmk-feature-module-physical-layout # プレビューに拡張モジュールを表示する場合だけ
#      remote: cormoran
#      revision: main

    # トラックボール
    - name: zmk-driver-pmw3610-with-custom-studio-rpc
      remote: cormoran
      revision: main
    - name: zmk-module-runtime-input-processor
      remote: cormoran
      revision: main

    # 接続先とOS
    - name: zmk-module-ble-management
      remote: cormoran
      revision: main
#    - name: zmk-feature-default-layer
#      remote: cormoran
#      revision: codex/custom-rpc-rewrite
#    - name: zmk-feature-os-detection
#      remote: cormoran
#      revision: main

    # 設定
    - name: zmk-module-settings-rpc
      remote: cormoran
      revision: main

    # 診断と開発補助
#    - name: zmk-feature-device-info
#      remote: cormoran
#      revision: main
    - name: zmk-feature-watchdog
      remote: cormoran
      revision: main
    - name: zmk-module-devtool
      remote: cormoran
      revision: main
#    - name: zmk-feature-zephyr-setting-expose
#      remote: cormoran
#      revision: main
#    - name: zmk-feature-kscan-diagnostics
#      remote: cormoran
#      revision: main

    # その他
#    - name: zmk-module-battery-history
#      remote: cormoran
#      revision: main

  self:
    path: config
```
